// SPDX-License-Identifier: (GPL-2.0-or-later OR BSD-3-Clause)
/*
 * Copyright (C) STMicroelectronics 2023 - All Rights Reserved
 * Author: Alexandre Torgue <alexandre.torgue@foss.st.com> for STMicroelectronics.
 */

/dts-v1/;

#include "stm32mp157.dtsi"
#include "stm32mp15xd.dtsi"
#include "stm32mp15-pinctrl.dtsi"
#include "stm32mp15xxac-pinctrl.dtsi"
#include "stm32mp15xx-dkx.dtsi"
#include "stm32mp157a-dk1-scmi.dtsi"

/ {
	model = "STMicroelectronics STM32MP157D-DK1 Discovery Board";
	compatible = "st,stm32mp157d-dk1", "st,stm32mp157";

	aliases {
		ethernet0 = &ethernet0;
	};

	chosen {
		stdout-path = "serial0:115200n8";
	};

	backlight: backlight {
		compatible = "pwm-backlight";
		pwm-names = "lcd-backlight";
		pwms = <&pwm5 1 50000 0>;
		brightness-levels = <
			100 99 98 97 96 95 94 93 92 91
			90 89 88 87 86 85 84 83 82 81
			80 79 78 77 76 75 74 73 72 71
			70 69 68 67 66 65 64 63 62 61
			60 59 58 57 56 55 54 53 52 51
			50 49 48 47 46 45 44 43 42 41
			40 39 38 37 36 35 34 33 32 31
			30 29 28 27 26 25 24 23 22 21
			20 19 18 17 16 15 14 13 12 11
			10  9  8  7  6  5  4  3  2  1
			 0
		>;
		default-brightness-level = <100>;
	};
};
